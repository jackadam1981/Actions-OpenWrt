// SPDX-License-Identifier: GPL-2.0-or-later OR MIT

#include "rt5350_hiker_x9.dtsi"

/*
 * P910ND 打印服务器版本，仅定义自身兼容 ID，硬件细节复用基础 hiker_x9.dtsi。
 */
/ {
	compatible = "hiker,x9-print", "hiker,x9", "ralink,rt5350-soc";
	model = "Hiker X9 Print";
};
