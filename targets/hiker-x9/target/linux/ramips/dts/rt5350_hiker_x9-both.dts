// SPDX-License-Identifier: GPL-2.0-or-later OR MIT

#include "rt5350_hiker_x9.dtsi"

/*
 * p910nd + VirtualHere (wired). Same hardware as other X9 profiles.
 */
/ {
	compatible = "hiker,x9-both", "hiker,x9", "ralink,rt5350-soc";
	model = "Hiker X9 Print + VirtualHere";
};
