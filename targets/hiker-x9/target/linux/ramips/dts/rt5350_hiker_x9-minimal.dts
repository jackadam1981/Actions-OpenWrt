// SPDX-License-Identifier: GPL-2.0-or-later OR MIT

#include "rt5350_hiker_x9.dtsi"

/*
 * Minimal profile only changes the model strings.
 */
/ {
	compatible = "hiker,x9-minimal", "hiker,x9", "ralink,rt5350-soc";
	model = "Hiker X9 Minimal";
};
