// SPDX-License-Identifier: GPL-2.0-or-later OR MIT

#include "rt5350_hiker_x9.dtsi"

/*
 * Full Wi-Fi profile, sharing the same hardware description.
 */
/ {
	compatible = "hiker,x9-full", "hiker,x9", "ralink,rt5350-soc";
	model = "Hiker X9 Full";
};
