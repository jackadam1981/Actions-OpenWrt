// SPDX-License-Identifier: GPL-2.0-or-later OR MIT

#include "rt5350_hiker_x9.dtsi"

/*
 * p910nd + VirtualHere + Wi-Fi AP stack.
 */
/ {
	compatible = "hiker,x9-both-wifi", "hiker,x9", "ralink,rt5350-soc";
	model = "Hiker X9 Print + VirtualHere WiFi";
};
