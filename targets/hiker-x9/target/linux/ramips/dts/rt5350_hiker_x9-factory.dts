// SPDX-License-Identifier: GPL-2.0-or-later OR MIT

#include "rt5350_hiker_x9.dtsi"

/*
 * Factory image helper profile:
 * - Intended for initial flashing from OEM (sysupgrade constraints may differ).
 * - Includes Breed auto-flash tooling via DEVICE_PACKAGES, not meant for normal profiles.
 */
/ {
	compatible = "hiker,x9-factory", "hiker,x9", "ralink,rt5350-soc";
	model = "Hiker X9 Factory";
};

