// SPDX-License-Identifier: GPL-2.0-or-later OR MIT

#include "rt5350_hiker_x9.dtsi"

/*
 * VirtualHere + WiFi profile for Hiker X9.
 */
/ {
	compatible = "hiker,x9-virtualhere-wifi", "hiker,x9", "ralink,rt5350-soc";
	model = "Hiker X9 VirtualHere WiFi";
};
