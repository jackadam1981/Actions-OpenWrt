// SPDX-License-Identifier: GPL-2.0-or-later OR MIT

#include "rt5350_hiker_x9.dtsi"

/*
 * VirtualHere USB server profile for Hiker X9.
 */
/ {
	compatible = "hiker,x9-virtualhere", "hiker,x9", "ralink,rt5350-soc";
	model = "Hiker X9 VirtualHere";
};
